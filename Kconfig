## Kconfig
```kconfig
config SOFLE_STATUS_SCREEN
    bool "Tela de status propria do Sofle (OLED em pe, com modificadores)"
    depends on ZMK_DISPLAY
    select LV_USE_CANVAS
    select LV_FONT_UNSCII_8

if SOFLE_STATUS_SCREEN

config SOFLE_STATUS_SCREEN_ROTATE_CW
    bool "Girar a tela 90 graus no sentido horario (senao, anti-horario)"
    default y

endif

config SOFLE_RGB_IDLE
    bool "Apagar os LEDs ao ficar ocioso e restaurar ao voltar (inclusive depois do sono)"
    depends on ZMK_RGB_UNDERGLOW
    default y
    help
      Substitui CONFIG_ZMK_RGB_UNDERGLOW_AUTO_OFF_IDLE, que nao restaura os LEDs depois do
      sono profundo. Use com AUTO_OFF_IDLE=n.
```

## dts/bindings/behaviors/sofle,behavior-oled-anim.yaml
```yaml
# SPDX-License-Identifier: MIT

description: Troca o estilo da animacao do OLED (Equalizador, Anel, Estrela, Nenhuma)

compatible: "sofle,behavior-oled-anim"

include: zero_param.yaml
```
